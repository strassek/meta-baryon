## conf/distro/baryon.conf
```bitbake
require conf/distro/poky.conf

DISTRO = "baryon"
DISTRO_NAME = "Baryon"
DISTRO_VERSION = "0.1+snapshot-${DATE}"

MAINTAINER = "Yocto Project <yocto@yoctoproject.org>"

DISTRO_FEATURES = "x11 argp ext2 largefile pcmcia usbhost wifi xattr nfs smbfs zeroconf pci ${DISTRO_FEATURES_LIBC}"

# Allow easily building with QEMU machines (see Yocto Project bugzilla bug #1690)
POKYQEMUDEPS = ""
```

## conf/layer.conf
```bitbake
# Layer configuration for meta-baryon layer
# Copyright 2011 Intel Corporation

# We have a conf directory, prepend to BBPATH to prefer our versions
BBPATH := "${LAYERDIR}:${BBPATH}"

# We have recipes-* directories, add to BBFILES
BBFILES := "${BBFILES} ${LAYERDIR}/recipes-*/*/*.bb ${LAYERDIR}/recipes-*/*/*.bbappend"

BBFILE_COLLECTIONS += "meta-baryon"
BBFILE_PATTERN_meta-baryon := "^${LAYERDIR}/"
BBFILE_PRIORITY_meta-baryon = "7"
```
